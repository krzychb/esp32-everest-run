## components/keenio/Kconfig.projbuild
```kconfig
menu "Posting data to Keen.IO"

config KEENIO_WRITE_API_KEY
    string "KeenIO write API key"
	default "1234567890123456789012345678901234567890123456789012345678901234"
	help
		API key obtained from 'https://keen.io/' site.
		
		You need to set up a free account on this site first.

config KEENIO_REQUEST_URL
    string "KeenIO project / collection specific request URL"
	default "/3.0/projects/123456789012345678901234/events/event-collection-name"
	help
		Request URL containing Project ID obtained from 'https://keen.io/' site
		
		and user defined event collection name.
		
		You need to set up a free account on this site first.


endmenu
```

## main/Kconfig.projbuild
```kconfig
menu "Example Configuration"

config BLINK_GPIO
    int "Blink GPIO number"
	range 0 34
	default 5
	help
		GPIO number (IOxx) to blink on and off.

		Some GPIOs are used for other purposes (flash connections, etc.) and cannot be used to blink.

		GPIOs 35-39 are input-only so cannot be used as outputs.

config WIFI_SSID
    string "WiFi SSID"
	default "myssid"
	help
		SSID (network name) for the example to connect to.

config WIFI_PASSWORD
    string "WiFi Password"
	default "myssid"
	help
		WiFi password (WPA or WPA2) for the example to use.

		Can be left blank if the network has no security set.

config OPENWEATHERMAP_API_KEY
    string "OpenWeatherMap API key"
	default "12345678901234567890123456789012"
	help
		API key obtained from 'https://home.openweathermap.org/' site.
		
		You need to set up a free account on this site first.

config THINGSPEAK_WRITE_API_KEY
    string "ThindSpeak write API key"
	default "1234567890123456"
	help
		API key obtained from 'https://thingspeak.com/' site.
		
		You need to set up a free account on this site first.

endmenu
```

## options/keenio/Kconfig.projbuild
```kconfig
menu "Posting data to Keen.IO"

config KEENIO_WRITE_API_KEY
    string "KeenIO write API key"
	default "1234567890123456789012345678901234567890123456789012345678901234"
	help
		API key obtained from 'https://keen.io/' site.
		
		You need to set up a free account on this site first.

config KEENIO_REQUEST_URL
    string "Request URL and Keen.IO project ID"
	default "/3.0/projects/123456789012345678901234/events"
	help
		Request URL containing Project ID obtained from 'https://keen.io/' site
		
		You need to set up a free account on this site first.

config KEENIO_EVENT_COLLECTION
    string "Name of event collection"
	default "everest-run-check"
	help
		Events will be saved / collected under this specific name
		
endmenu
```
